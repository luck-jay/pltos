## Kconfig
```kconfig
#
# For a description of the syntax of this configuration file,
#
mainmenu "Configuration"

menu "Compiler options"

config CROSS_COMPILE
    string "Cross-compiler tool prefix"
    help
        Same as running 'make CROSS_COMPILE=prefix-' but stored for
        default make runs in this application build directory.  You don't
        need to set this unless you want the configured application build
        directory to select the cross-compiler automatically.

config DEBUG
	bool "Enable debug option"
	help
	    This option allows debugging information to be included in the compiled bin file

endmenu

menu "System options"

choice
    prompt "Set system clock hz"
    default SYSTEM_CLOCK_1000HZ

config SYSTEM_CLOCK_1000HZ
    bool "System clock 1000hz"

config SYSTEM_CLOCK_250HZ
    bool "System clock 250hz"

config SYSTEM_CLOCK_100HZ
    bool "System clock 100hz"

config SYSTEM_CLOCK_10HZ
    bool "System clock 10hz"

endchoice

config KERNEL_NAME_MAX_SIZE
    int "name max szie for kenrl"
    default 20
    help
        set system max name size.

config LOG
    bool "log enable"
    default y

config LOG_LEVEL
    int "Log Level setting"
    depends on LOG
    default 3
    range 0 3
    help
        LOG_LEVEL_ERROR   0
        LOG_LEVEL_WARNING 1
        LOG_LEVEL_INFO    2
        LOG_LEVEL_DEBUG   3

endmenu

source "arch/Kconfig"
source "kernel/Kconfig"
source "libs/Kconfig"
source "app/Kconfig"
```

## app/Kconfig
```kconfig
menu "Application options"

config APP_PLTSH
    bool "Pltsh enable"
    default n
    help
        enable pltsh.

endmenu
```

## arch/Kconfig
```kconfig
menu "CPU Arch"

choice
    prompt "Arch select for cpu"
    default CORTEX_M3

config CORTEX_M0
    bool "CPU arch for cortex-m0"

config CORTEX_M3
    bool "CPU arch for cortex-m3"

config CORTEX_M4
    bool "CPU arch for cortex-m4"

endchoice

config ARCH
	string
	default "cortex-m0" if CORTEX_M0
	default "cortex-m3" if CORTEX_M3
	default "cortex-m4" if CORTEX_M4

source "arch/cortex-m3/Kconfig"

endmenu
```

## arch/cortex-m3/Kconfig
```kconfig
choice
    prompt "Select CPU type"
    depends on CORTEX_M3
    default STM32F10X

config STM32F10X
    bool "stm32f10x"

endchoice

source "arch/cortex-m3/stm32f1x/Kconfig"
```

## arch/cortex-m3/stm32f1x/Kconfig
```kconfig
choice
    prompt "Select stm32 type"
    depends on STM32F10X
    default STM32_HIGH_CAPACITY

config STM32_LOW_CAPACITY
    bool "Low capacity type"

config STM32_MID_CAPACITY
    bool "Mid capacity type"

config STM32_HIGH_CAPACITY
    bool "High capacity type"

endchoice
```
